## CogletESP/main/Kconfig.projbuild
```kconfig
menu "Xiaozhi Assistant"

config OTA_URL
    string "Default OTA URL"
    default "https://api.tenclass.net/xiaozhi/ota/"
    help
        The application will access this URL to check for new firmwares and server address.

# Coglet always flashes the generated default assets: they hold the wake word
# models, and the song library lives at the end of the same partition.
config FLASH_DEFAULT_ASSETS
    bool
    default y

choice
    prompt "Default Language"
    default LANGUAGE_EN_US
    help
        Select device display language

    config LANGUAGE_ZH_CN
        bool "Chinese"
    config LANGUAGE_ZH_TW
        bool "Chinese Traditional"
    config LANGUAGE_EN_US
        bool "English"
    config LANGUAGE_JA_JP
        bool "Japanese"
    config LANGUAGE_KO_KR
        bool "Korean"
    config LANGUAGE_VI_VN
        bool "Vietnamese"
    config LANGUAGE_TH_TH
        bool "Thai"
    config LANGUAGE_DE_DE
        bool "German"
    config LANGUAGE_FR_FR
        bool "French"
    config LANGUAGE_ES_ES
        bool "Spanish"
    config LANGUAGE_IT_IT
        bool "Italian"
    config LANGUAGE_RU_RU
        bool "Russian"
    config LANGUAGE_AR_SA
        bool "Arabic"
    config LANGUAGE_HI_IN
        bool "Hindi"
    config LANGUAGE_PT_PT
        bool "Portuguese"
    config LANGUAGE_PL_PL
        bool "Polish"
    config LANGUAGE_CS_CZ
        bool "Czech"
    config LANGUAGE_FI_FI
        bool "Finnish"
    config LANGUAGE_TR_TR
        bool "Turkish"
    config LANGUAGE_ID_ID
        bool "Indonesian"
    config LANGUAGE_UK_UA
        bool "Ukrainian"
    config LANGUAGE_RO_RO
        bool "Romanian"
    config LANGUAGE_BG_BG
        bool "Bulgarian"
    config LANGUAGE_CA_ES
        bool "Catalan"
    config LANGUAGE_DA_DK
        bool "Danish"
    config LANGUAGE_EL_GR
        bool "Greek"
    config LANGUAGE_FA_IR
        bool "Persian"
    config LANGUAGE_FIL_PH
        bool "Filipino"
    config LANGUAGE_HE_IL
        bool "Hebrew"
    config LANGUAGE_HR_HR
        bool "Croatian"
    config LANGUAGE_HU_HU
        bool "Hungarian"
    config LANGUAGE_MS_MY
        bool "Malay"
    config LANGUAGE_NB_NO
        bool "Norwegian"
    config LANGUAGE_NL_NL
        bool "Dutch"
    config LANGUAGE_SK_SK
        bool "Slovak"
    config LANGUAGE_SL_SI
        bool "Slovenian"
    config LANGUAGE_SV_SE
        bool "Swedish"
    config LANGUAGE_SR_RS
        bool "Serbian"
endchoice

choice BOARD_TYPE
    prompt "Board Type"
    default BOARD_TYPE_COGNOG_V3
    help
        Coglet firmware supports one board.

    config BOARD_TYPE_COGNOG_V3
        bool "NMRobotics Coglet (CogNog V3.0 PCB)"
        depends on IDF_TARGET_ESP32S3
        help
            Coglet desktop companion on the CogNog V3.0 PCB (ESP32-S3 + RP2040,
            GC0308 camera, I2S mic and MAX98357A amplifier, no display).
            Reports its own board type ("cognog-v3") to the OTA server, so no
            generic xiaozhi firmware is ever offered to it.
endchoice

config COGLET_BOARD
    bool
    default y if BOARD_TYPE_COGNOG_V3
    help
        Set for the Coglet hardware. Shared Coglet-only code checks this symbol.

# Coglet always uses the MultiNet custom wake word: the web flasher's Settings
# change the wake phrase, which only works with this model.
config USE_CUSTOM_WAKE_WORD
    bool
    default y
    depends on IDF_TARGET_ESP32S3 && SPIRAM

config CUSTOM_WAKE_WORD
    string "Custom Wake Word"
    default "hello coglet"
    depends on USE_CUSTOM_WAKE_WORD
    help
        Wake phrase in English words, separated by spaces. The web flasher's
        Settings can override it without rebuilding.

config CUSTOM_WAKE_WORD_DISPLAY
    string "Custom Wake Word Display"
    default "Hello Coglet"
    depends on USE_CUSTOM_WAKE_WORD
    help
        Text sent to the server after the wake word is detected.

config USE_SECONDARY_CUSTOM_WAKE_WORD
    bool "Enable Secondary Custom Wake Word"
    default n
    depends on USE_CUSTOM_WAKE_WORD
    help
        Enable a second custom wake word. Both the primary and secondary
        wake words trigger the same wake action.

config SECONDARY_CUSTOM_WAKE_WORD
    string "Secondary Custom Wake Word"
    default "hello esp"
    depends on USE_CUSTOM_WAKE_WORD && USE_SECONDARY_CUSTOM_WAKE_WORD
    help
        Second wake phrase in English words, separated by spaces.

config SECONDARY_CUSTOM_WAKE_WORD_DISPLAY
    string "Secondary Custom Wake Word Display"
    default "Hello ESP"
    depends on USE_CUSTOM_WAKE_WORD && USE_SECONDARY_CUSTOM_WAKE_WORD
    help
        Text sent to the server after the secondary wake word is detected.

config CUSTOM_WAKE_WORD_THRESHOLD
    int "Custom Wake Word Threshold (%)"
    default 20
    range 1 99
    depends on USE_CUSTOM_WAKE_WORD
    help
        Wake word threshold, 1-99: the smaller, the more sensitive.
        The web flasher's Settings can override this (and the wake word)
        without rebuilding.

config SEND_WAKE_WORD_DATA
    bool "Send Wake Word Data"
    default y
    depends on USE_CUSTOM_WAKE_WORD
    help
        Send the wake word audio to the server as the first message of the
        conversation and wait for the response.

# The AFE (noise reduction, VAD, device-side AEC) is always used on Coglet.
config USE_AUDIO_PROCESSOR
    bool
    default y
    depends on IDF_TARGET_ESP32S3 && SPIRAM

config USE_DEVICE_AEC
    bool "Enable Device-Side AEC"
    default n
    depends on USE_AUDIO_PROCESSOR && COGLET_BOARD
    help
        Lets the user talk over Coglet: it keeps listening while it speaks.
        Coglet has no hardware reference path; the reference is taken
        digitally from the speaker I2S DMA (software loopback). Enabling this
        also enables realtime listening, so the user can interrupt Coglet
        while it speaks.

config COGLET_AEC_REF_DELAY_MS
    int "Coglet AEC reference delay (ms)"
    default 0
    range -10 20
    depends on USE_DEVICE_AEC && COGLET_BOARD
    help
        Time offset between the speaker reference and the microphone, for the Coglet software
        AEC reference. Each mic sample captured at time t is paired with the speaker sample
        played at (t - delay). The reference must not arrive later than the echo, so keep
        this at or below the real acoustic delay (normally 0..2 ms on Coglet).
        Leave at 0 unless an Audio Debugger capture shows the echo leading the reference.

config COGLET_AEC_DEFAULT_OFF
    bool "Coglet: start with device AEC off (web flasher Settings can turn it on)"
    default n
    depends on USE_DEVICE_AEC && COGLET_BOARD
    help
        Builds device-side AEC in, but leaves it off unless the web flasher's
        Settings turn it on ("Talk over Coglet"). Without AEC the audio path
        is exactly the one of a build without it. The published firmware
        uses this; leave it off to have AEC on by default.

config COGLET_MIC_DIAG_LOG
    bool "Coglet: log microphone levels every second"
    default n
    depends on COGLET_BOARD
    help
        Prints one "[MIC] ..." line per second (raw peak, DC, AC and PCM
        levels, clipping; with device AEC also the "[AEC-REF]" reference
        alignment). Only useful when checking the microphone wiring or AEC
        timing; off by default so the log stays readable.

config USE_AUDIO_DEBUGGER
    bool "Enable Audio Debugger"
    default n
    help
        Enable audio debugger, send audio data through UDP to the host machine

config AUDIO_DEBUG_UDP_SERVER
    string "Audio Debug UDP Server Address"
    default "192.168.2.100:8000"
    depends on USE_AUDIO_DEBUGGER
    help
        UDP server address, format: IP:PORT, used to receive audio debugging data

menu "Camera Configuration"
    config XIAOZHI_ENABLE_CAMERA_DEBUG_MODE
        bool "Enable Camera Debug Mode"
        default n
        help
            Enable camera debug mode, print camera debug information to the console.
            Only works on boards that support camera.
endmenu

endmenu

# NMRobotics Coglet: local reminders.
menu "NMRobotics Coglet Reminder"

    config COGLET_REMINDER_SPEAK
        bool "Speak the reminder after the chime"
        default y
        help
            When a reminder fires (idle or in the middle of a conversation),
            Coglet plays the reminder chime, then opens a short session in which
            the LLM fetches the reminder text (self.coglet.reminder.last_due) and
            says it, and finally returns to standby by itself.
            Off: only the chime plays (original behaviour).

    choice COGLET_REMINDER_TZ_SOURCE
        prompt "Reminder time zone"
        default COGLET_REMINDER_TZ_AUTO
        help
            Reminders are entered and spoken in the device's local time.

        config COGLET_REMINDER_TZ_AUTO
            bool "Automatic (time zone offset sent by the xiaozhi server)"
            help
                Uses server_time.timezone_offset from the OTA check. Falls back
                to UTC+08:00 until the server has answered. A fixed offset does
                not know about future daylight-saving changes.

        config COGLET_REMINDER_TZ_MANUAL
            bool "Manual (POSIX TZ string)"
    endchoice

    config COGLET_REMINDER_TZ
        string "POSIX TZ string"
        default "CST-8"
        depends on COGLET_REMINDER_TZ_MANUAL
        help
            Note the inverted sign of POSIX offsets. Examples:
              Beijing           CST-8
              Berlin / Paris    CET-1CEST,M3.5.0,M10.5.0/3
              London            GMT0BST,M3.5.0/1,M10.5.0
              New York          EST5EDT,M3.2.0,M11.1.0
            Daylight-saving rules are applied automatically.

endmenu

# NMRobotics Coglet: automatic RP2040 updates.
menu "NMRobotics Coglet RP2040"

    config COGLET_RP2040_SYNC
        bool "Update the RP2040 program automatically"
        default y
        help
            The ESP firmware carries the RP2040 program (CogletESP/RP2040).
            A few seconds after boot the ESP asks the RP2040 which version it
            runs and, if it differs, sends the new files over the UART link.
            The RP2040 stages and verifies them before switching, and keeps
            its old program if anything goes wrong. The RP2040 needs the
            one-time setup (web flasher) once, from before this feature.

endmenu

# NMRobotics Coglet: built-in music dance.
menu "NMRobotics Coglet Dance"

    config COGLET_DANCE
        bool "Built-in music dance (MCP tool self.coglet.dance)"
        default y
        help
            Adds three ~30 s dance tracks (~460 KB of flash; which three is
            set by "Firmware edition" below) and the MCP tool
            self.coglet.dance. When the user asks Coglet to dance, the session
            is closed, the track plays while the RP2040 (music.py) performs the
            matching hard-coded choreography, and afterwards Coglet opens a new
            session by itself and asks how the dance was.
            Off: no tracks are linked and the tool is not registered.

    choice COGLET_EDITION
        prompt "Firmware edition"
        depends on COGLET_DANCE
        default COGLET_EDITION_STANDARD
        help
            Which three built-in dances are in the firmware. Only one set is
            linked, so the editions take about the same flash. The web flasher
            offers them all: switching edition is a normal update, and settings
            and songs added on the page are kept. The RP2040 program knows the
            choreographies of every edition, so it doesn't change between them.

        config COGLET_EDITION_STANDARD
            bool "Standard (Mecha, Evil, Cat)"

        config COGLET_EDITION_CHRISTMAS
            bool "Christmas (Silent Night, Jingle Bells, Joy to the World)"
            help
                Dances: lyrical (Silent Night), classic (Jingle Bells), grand
                (Joy to the World). Public-domain carols in our own
                arrangements. Startup and reminder sounds default to the
                Christmas ones.

        config COGLET_EDITION_ELF
            bool "Elf (Deck the Halls, God Rest Ye Merry Gentlemen, We Wish You a Merry Christmas)"
            help
                Dances: workshop (Deck the Halls), mischief (God Rest Ye Merry
                Gentlemen), party (We Wish You a Merry Christmas). Traditional
                carols in our own arrangements. Startup and reminder sounds
                default to the Elf ones.

        config COGLET_EDITION_SNOWMAN
            bool "Snowman (Brahms' Lullaby, Good King Wenceslas, Carol of the Bells)"
            help
                Dances: lullaby (Brahms' Lullaby), stomp (Good King
                Wenceslas), blizzard (Leontovych's Shchedryk, known as Carol of
                the Bells). Public-domain music in our own arrangements.
                Startup and reminder sounds default to the Snowman ones.
    endchoice

    config COGLET_MUSIC
        bool "Custom songs from the Music folder"
        depends on COGLET_DANCE
        default y
        help
            Every audio file in CogletESP/Music/ (mp3, wav, flac, m4a, ogg,
            or the audio of mp4/mov videos) is converted to Opus and
            beat-analysed at build time, then compiled in. Coglet dances to
            these songs with an automatic "energetic" or "calm" preset.
            Force a preset or tempo with tags in the file name, e.g.
            "My Song.calm.mp3" or "Drop.energetic.128bpm.wav".
            Needs ffmpeg (with libopus) on the build computer; without it the
            songs are skipped with a warning and the build continues.

    config COGLET_MUSIC_FFMPEG
        string "ffmpeg executable"
        depends on COGLET_MUSIC
        default "ffmpeg"
        help
            Name or full path of ffmpeg. Use forward slashes on Windows,
            e.g. C:/ffmpeg/bin/ffmpeg.exe

    config COGLET_MUSIC_MAX_SECONDS
        int "Maximum length per song (seconds)"
        depends on COGLET_MUSIC
        range 10 300
        default 60
        help
            Longer songs are cut here with a fade-out.

    config COGLET_MUSIC_BITRATE_KBPS
        int "Opus bitrate (kbps)"
        depends on COGLET_MUSIC
        range 16 64
        default 32
        help
            32 kbps is ~240 KB per minute and sounds clean on Coglet's speaker.

    config COGLET_MUSIC_MAX_KB
        int "Flash budget for all custom songs (KB)"
        depends on COGLET_MUSIC
        range 100 2500
        default 400
        help
            Songs that do not fit are skipped with a warning. They are
            compiled into the app, and the 4 MB app partition has roughly
            this much room left; raising it can make the build fail with
            "app partitions are too small". Songs added from the web
            flasher have their own storage (COGLET_MUSIC_LIBRARY_KB).

    config COGLET_MUSIC_LIBRARY_KB
        int "Song library size (KB, end of the assets partition)"
        depends on COGLET_MUSIC
        range 0 4096
        default 2048
        help
            Songs added from the web flasher ("My songs") are stored in the
            last part of the "assets" partition, which the assets image does
            not use. Firmware updates never write there, so the songs are
            kept. 2048 KB holds about 8 one-minute songs. 0 turns the library
            off. The web flasher reads this value from the build, so keep the
            published firmware and this setting in step.

    config COGLET_MUSIC_BEAT_OFFSET_MS
        int "Beat timing offset (ms)"
        depends on COGLET_MUSIC
        range -300 300
        default 20
        help
            When a beat is sent to the RP2040 relative to the music:
            speaker latency (~120 ms) minus the servo lead (~100 ms).
            Moves late -> lower it; moves early -> raise it.

endmenu

# NMRobotics unified firmware: startup / reminder sound selection.
# Reminder itself is mandatory; only its sound can be selected.
menu "NMRobotics Coglet Sounds"

    choice COGLET_BOOT_SOUND
        prompt "Startup Sound"
        default COGLET_BOOT_SOUND_CHRISTMAS if COGLET_EDITION_CHRISTMAS
        default COGLET_BOOT_SOUND_ELF if COGLET_EDITION_ELF
        default COGLET_BOOT_SOUND_SNOWMAN if COGLET_EDITION_SNOWMAN
        default COGLET_BOOT_SOUND_MECHA
        help
            Default startup sound. Independent of the device shell. All of them
            are in the firmware; the web flasher's Settings can switch between
            them without rebuilding.

        config COGLET_BOOT_SOUND_MECHA
            bool "Mecha Startup (Rider Awakening V2)"

        config COGLET_BOOT_SOUND_EVIL
            bool "Evil Startup (Devil Awakening)"

        config COGLET_BOOT_SOUND_CAT
            bool "Cat Startup (Neko Boot V2)"

        config COGLET_BOOT_SOUND_CHRISTMAS
            bool "Christmas Startup (Sleigh Bells)"

        config COGLET_BOOT_SOUND_ELF
            bool "Elf Startup (Wind-up Toy)"

        config COGLET_BOOT_SOUND_SNOWMAN
            bool "Snowman Startup (Ice Chimes)"

    endchoice

    choice COGLET_REMINDER_SOUND
        prompt "Reminder Sound"
        default COGLET_REMINDER_SOUND_CHRISTMAS if COGLET_EDITION_CHRISTMAS
        default COGLET_REMINDER_SOUND_ELF if COGLET_EDITION_ELF
        default COGLET_REMINDER_SOUND_SNOWMAN if COGLET_EDITION_SNOWMAN
        default COGLET_REMINDER_SOUND_MECHA
        help
            Default sound played when a local Reminder fires. All of them are
            in the firmware; the web flasher's Settings can switch between
            them without rebuilding. Reminder MCP, local timing and NVS
            persistence are always on.

        config COGLET_REMINDER_SOUND_MECHA
            bool "Mecha Reminder (Rider Signal V2)"

        config COGLET_REMINDER_SOUND_EVIL
            bool "Evil Reminder (Devil's Invitation)"

        config COGLET_REMINDER_SOUND_CAT
            bool "Cat Reminder (Gentle Chime)"

        config COGLET_REMINDER_SOUND_CHRISTMAS
            bool "Christmas Reminder (Church Bells)"

        config COGLET_REMINDER_SOUND_ELF
            bool "Elf Reminder (Toy Clock)"

        config COGLET_REMINDER_SOUND_SNOWMAN
            bool "Snowman Reminder (Icicles)"

    endchoice

endmenu
```
